## boards/arm/nucleo_wb55rg/nucleo_wb55rg_defconfig
```kconfig
CONFIG_ARM=y
CONFIG_SOC_SERIES_STM32WBX=y
CONFIG_SOC_STM32WB55XX=y
# 32MHz system clock
#CONFIG_SYS_CLOCK_HW_CYCLES_PER_SEC=32000000
CONFIG_SYS_CLOCK_HW_CYCLES_PER_SEC=64000000

# enable uart driver
CONFIG_SERIAL=y

# enable pinmux
CONFIG_PINMUX=y

# enable GPIO
CONFIG_GPIO=y

# clock configuration
CONFIG_CLOCK_CONTROL=y
# SYSCLK selection
CONFIG_CLOCK_STM32_SYSCLK_SRC_PLL=y
#CONFIG_CLOCK_STM32_PLL_SRC_HSI=y
CONFIG_CLOCK_STM32_PLL_SRC_MSI=y
#CONFIG_CLOCK_STM32_SYSCLK_SRC_HSE=y
#CONFIG_CLOCK_STM32_HSE_CLOCK=32000000
#CONFIG_CLOCK_STM32_HSI_CLOCK=16000000
CONFIG_CLOCK_STM32_PLL_M_DIVISOR=1
CONFIG_CLOCK_STM32_PLL_P_DIVISOR=2
CONFIG_CLOCK_STM32_PLL_Q_DIVISOR=4
CONFIG_CLOCK_STM32_PLL_R_DIVISOR=5

#CONFIG_CLOCK_STM32_PLL_N_MULTIPLIER=8
CONFIG_CLOCK_STM32_PLL_N_MULTIPLIER=32

CONFIG_CLOCK_STM32_CPU1_PRESCALER=1
CONFIG_CLOCK_STM32_CPU2_PRESCALER=2
CONFIG_CLOCK_STM32_APB1_PRESCALER=1
CONFIG_CLOCK_STM32_APB2_PRESCALER=1
CONFIG_CLOCK_STM32_AHB4_PRESCALER=1

# console
CONFIG_CONSOLE=y
CONFIG_UART_CONSOLE=y

# Enable MPU
CONFIG_ARM_MPU=y

CONFIG_USE_STM32_HAL_RCC=y
CONFIG_USE_STM32_HAL_RCC_EX=y
CONFIG_USE_STM32_HAL_PWR=y
CONFIG_USE_STM32_HAL_PWR_EX=y
```
